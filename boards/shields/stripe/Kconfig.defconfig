## boards/shields/stripe/Kconfig.defconfig
```kconfig
if SHIELD_STRIPE_LEFT

config ZMK_KEYBOARD_NAME
    default "Stripe"

config ZMK_SPLIT_ROLE_CENTRAL
    default y

endif # SHIELD_STRIPE_LEFT

if SHIELD_STRIPE_LEFT || SHIELD_STRIPE_RIGHT

config ZMK_SPLIT
    default y

endif # SHIELD_STRIPE_LEFT || SHIELD_STRIPE_RIGHT
```

## boards/shields/stripe/Kconfig.shield
```kconfig
config SHIELD_STRIPE_LEFT
    def_bool $(shields_list_contains,stripe_left)

config SHIELD_STRIPE_RIGHT
    def_bool $(shields_list_contains,stripe_right)
```
